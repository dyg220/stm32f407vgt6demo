#include "function.h"

/**************************************************************
*函数功能：光照强度检测初始化
*参    数：None
*返 回 值：None
*备    注：PC0-----ADC1_CH10
**************************************************************/
void Light_Init(void)
{
	ADC1_CH10_Init();
}

/**************************************************************
*函数功能：光照强度获取
*参    数：None
*返 回 值：None
*备    注：PC0-----ADC1_CH10
**************************************************************/
u16 Get_Light_VAL(void)
{
	u16 temp = 0;
	float val = 0;
	ADC1->CR2 |= (1 << 30);//软件触发转换
	while (!(ADC1->SR & (1 << 1)));//等待转换完成
	temp = ADC1->DR;//还有清除标志位的功能
	val = (float)(4095 - temp) / 4095.0f * 100;
	printf("Light:%.1f%%\r\n", val);
	return val;
}


/**************************************************************
*函数功能：毒气检测初始化
*参    数：None
*返 回 值：None
*备    注：PC2-----ADC2_CH12
**************************************************************/
void MQ2_Init(void)
{
	ADC2_CH12_Init();
}

/**************************************************************
*函数功能：毒气获取
*参    数：None
*返 回 值：None
*备    注：PC2-----ADC2_CH12
**************************************************************/
u16 Get_MQ2_VAL(void)
{
	u16 temp = 0;
	float val = 0;
	ADC2->CR2 |= (1 << 30);//软件触发转换
	while (!(ADC2->SR & (1 << 1)));//等待转换完成
	temp = ADC2->DR;//还有清除标志位的功能
	val = (float)temp / 4095.0f * 100;
	printf("MQ2:%.1f%%\r\n", val);
	return val;
}



/**************************************************************
*函数功能：光照强度和毒气检测初始化
*参    数：None
*返 回 值：None
*备    注：PC0-----ADC1_CH10     PC2-----ADC1_CH12
**************************************************************/
void Light_MQ2_Init(void)
{
	ADC1_CH10_CH12_Init();
}


/**************************************************************
*函数功能：光照和毒气获取
*参    数：None
*返 回 值：None
*备    注：PC0-----ADC1_CH10     PC2-----ADC1_CH12
**************************************************************/
ADC_t Get_Light_MQ2_VAL(void)
{
	u16 temp1 = 0, temp2 = 0;
	ADC_t val = { 0 };
	ADC1->CR2 |= (1 << 30);//软件触发转换
	while (!(ADC1->SR & (1 << 1)));//等待转换完成EOC=1
	temp1 = ADC1->DR;//还有清除标志位的功能   //拿的光照值
	while (!(ADC1->SR & (1 << 1)));//等待转换完成EOC=1
	temp2 = ADC1->DR;//还有清除标志位的功能   //毒气

	val.light_data = (float)(4095 - temp1) / 4095.0f * 100;
	printf("Light:%.1f%%\r\n", val.light_data);

	val.mq2_data = (float)temp2 / 4095.0f * 100;
	printf("MQ2:%.1f%%\r\n", val.mq2_data);
	return val;
}



/**************************************************************
*函数功能：光照和毒气初始化（中断）
*参    数：None
*返 回 值：None
*备    注：PC0-----ADC1_CH10     PC2-----ADC1_CH12
**************************************************************/
void Get_Light_MQ2_Intrerupt_VAL(void)
{
	ADC1_CH10_CH12_Interrupt_Init();
}


/**************************************************************
*函数功能：光照强度和毒气、温度检测初始化
*参    数：None
*返 回 值：None
*备    注：PC0-----ADC1_CH10     PC2-----ADC1_CH12  TEMP
**************************************************************/
void Light_MQ2_T_Init(void)
{
	ADC1_CH10_CH12_T_Init();
}


/**************************************************************
*函数功能：光照和毒气获取
*参    数：None
*返 回 值：None
*备    注：PC0-----ADC1_CH10     PC2-----ADC1_CH12
**************************************************************/
ADC_t Get_Light_MQ2_T_VAL(void)
{
	u16 temp1 = 0, temp2 = 0, temp3 = 0;
	ADC_t val = { 0 };
	ADC1->CR2 |= (1 << 30);//软件触发转换
	while (!(ADC1->SR & (1 << 1)));//等待转换完成EOC=1
	temp1 = ADC1->DR;//还有清除标志位的功能   //拿的光照值
	while (!(ADC1->SR & (1 << 1)));//等待转换完成EOC=1
	temp2 = ADC1->DR;//还有清除标志位的功能   //毒气
	while (!(ADC1->SR & (1 << 1)));//等待转换完成EOC=1
	temp3 = ADC1->DR;//还有清除标志位的功能   //毒气

	val.light_data = (float)(4095 - temp1) / 4095.0f * 100;
	printf("Light:%.1f%%\r\n", val.light_data);

	val.mq2_data = (float)temp2 / 4095.0f * 100;
	printf("MQ2:%.1f%%\r\n", val.mq2_data);

	val.temp_data = (float)temp3 / 4095.0f * 3.3f;//转为对应电压值
	val.temp_data = ((val.temp_data - 0.76f) / 0.0025f) + 25;
	printf("TEMP:%.1f%%\r\n", val.temp_data);
	return val;
}




